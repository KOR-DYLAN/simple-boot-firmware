## arch/KConfig
```kconfig
# Copyright (c) 2026 simple-boot contributors
# SPDX-License-Identifier: MIT
#
# File: arch/KConfig
# Brief: Compose architecture configuration symbols.

config ARCH
    bool "Architecture support"
    default y

source "arch/aarch64/KConfig"
source "arch/aarch32/KConfig"
source "arch/cortex-m/KConfig"
```

## arch/aarch32/KConfig
```kconfig
# Copyright (c) 2026 simple-boot contributors
# SPDX-License-Identifier: MIT
#
# File: arch/aarch32/KConfig
# Brief: Define AArch32 architecture selection.

config ARCH_AARCH32
    bool "AArch32 startup"
    depends on ARCH
    default n
```

## arch/aarch64/KConfig
```kconfig
# Copyright (c) 2026 simple-boot contributors
# SPDX-License-Identifier: MIT
#
# File: arch/aarch64/KConfig
# Brief: Define AArch64 architecture selection.

config ARCH_AARCH64
    bool "AArch64 startup"
    depends on ARCH
    default n
```

## arch/cortex-m/KConfig
```kconfig
# Copyright (c) 2026 simple-boot contributors
# SPDX-License-Identifier: MIT
#
# File: arch/cortex-m/KConfig
# Brief: Define Cortex-M architecture selection.

config ARCH_CORTEX_M
    bool "Cortex-M startup"
    depends on ARCH
    default n
```

## boot/KConfig
```kconfig
# Copyright (c) 2026 simple-boot contributors
# SPDX-License-Identifier: MIT
#
# File: boot/KConfig
# Brief: Define boot image generation.

config BOOT
    bool "Boot image"
    default y

config BOOTLOADER1
    bool "Bootloader1 image"
    depends on BOOT
    default y

config BOOTLOADER2
    bool "Bootloader2 image"
    depends on BOOT
    default y

config BOOTLOADER2_AUTO_BOOT
    bool "Jump from bootloader2 to the payload"
    depends on BOOTLOADER2
    default n

config PAYLOAD_LOAD_ADDRESS
    hex "Payload load address"
    default 0x0

config PAYLOAD_ENTRY_ADDRESS
    hex "Payload entry address"
    default 0x0

config PAYLOAD_ARGUMENT_0
    hex "Payload argument register 0"
    default 0x0

config PAYLOAD_ARGUMENT_1
    hex "Payload argument register 1"
    default 0x0

config PAYLOAD_ARGUMENT_2
    hex "Payload argument register 2"
    default 0x0

config PAYLOAD_ARGUMENT_3
    hex "Payload argument register 3"
    default 0x0
```

## boot/bl1/KConfig
```kconfig
# Copyright (c) 2026 simple-boot contributors
# SPDX-License-Identifier: MIT
#
# File: boot/bl1/KConfig
# Brief: Define bootloader1 image selection.

config BOOTLOADER1
    bool "Bootloader1 image"
    depends on BOOT
    default y
```

## library/runtime/KConfig
```kconfig
# Copyright (c) 2026 simple-boot contributors
# SPDX-License-Identifier: MIT
#
# File: library/runtime/KConfig
# Brief: Define runtime initialization sources.

config RUNTIME
    bool "Assembly runtime initialization"
    depends on LIBRARY
    default y

config RUNTIME_AARCH64
    bool "AArch64 runtime source"
    depends on RUNTIME
    default n

config RUNTIME_AARCH32
    bool "AArch32 and Cortex-M runtime source"
    depends on RUNTIME
    default n
```

## platform/qemu/KConfig
```kconfig
# Copyright (c) 2026 simple-boot contributors
# SPDX-License-Identifier: MIT
#
# File: platform/qemu/KConfig
# Brief: Compose QEMU board configuration symbols.

config PLATFORM_QEMU
    bool "QEMU platforms"
    depends on PLATFORM
    default n

config QEMU_RAM_SIZE
    string "QEMU main RAM size"
    default "128M"

config QEMU_CPU_COUNT
    int "QEMU CPU count"
    default 1

source "platform/qemu/virt/KConfig"
source "platform/qemu/virt-secure/KConfig"
source "platform/qemu/mps2-an385/KConfig"
```

## platform/qemu/virt-secure/KConfig
```kconfig
# Copyright (c) 2026 simple-boot contributors
# SPDX-License-Identifier: MIT
#
# File: platform/qemu/virt-secure/KConfig
# Brief: Define the QEMU virt secure-reset platform selection.

config PLATFORM_QEMU_VIRT_SECURE
    bool "QEMU virt secure reset"
    depends on PLATFORM_QEMU
    default n

config SECURE_BOOT
    bool "Remain in the highest secure boot mode"
    depends on PLATFORM_QEMU_VIRT_SECURE
    default n
```
